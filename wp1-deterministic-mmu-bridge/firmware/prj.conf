## CMakeLists.txt
```
# SPDX-License-Identifier: AGPL-3.0-only
cmake_minimum_required(VERSION 3.20.0)
# NCS owns the board definitions; see hardware-vendor/MANIFEST.md for the pin.
set(DTC_OVERLAY_FILE "${CMAKE_CURRENT_SOURCE_DIR}/../hardware-vendor/overlays/thingy91x_nrf5340_cpuapp.overlay")
find_package(Zephyr REQUIRED HINTS $ENV{ZEPHYR_BASE})
project(live_thingy91x C)
set_property(TARGET app PROPERTY C_STANDARD 99)
set_property(TARGET app PROPERTY C_STANDARD_REQUIRED ON)
target_sources(app PRIVATE src/main.c src/conflict_monitor.c)
```

## sysbuild.conf
```
# SPDX-License-Identifier: AGPL-3.0-only
SB_CONFIG_NETCORE_IPC_RADIO=y

SB_CONFIG_NETCORE_IPC_RADIO_BT_HCI_IPC=y
```

## prj.conf
```kconfig
# SPDX-License-Identifier: AGPL-3.0-only
CONFIG_GPIO=y
CONFIG_WATCHDOG=y
CONFIG_BT=y
CONFIG_BT_CENTRAL=y
CONFIG_BT_MAX_CONN=2
# TX power belongs to cpunet: see sysbuild/ipc_radio.conf (+3 dBm, not +8).
CONFIG_NETWORKING=y
CONFIG_NET_SOCKETS=y
CONFIG_NET_TCP=y
CONFIG_MQTT_LIB=y
CONFIG_MQTT_LIB_TLS=y
CONFIG_NET_SOCKETS_SOCKOPT_TLS=y
CONFIG_MBEDTLS=y
CONFIG_MAIN_STACK_SIZE=4096
# No Wi-Fi/modem driver, destination, connection attempt or delivery transport.
# NCS crypto backend is required to link native TLS sockets.
CONFIG_NRF_SECURITY=y
CONFIG_MBEDTLS_TLS_LIBRARY=y
CONFIG_MBEDTLS_HEAP_SIZE=81920
# Bounded TLS 1.2 ECDHE/ECDSA + AES-GCM capability; no credentials provisioned.
CONFIG_PSA_WANT_GENERATE_RANDOM=y
CONFIG_PSA_WANT_ALG_SHA_256=y
CONFIG_PSA_WANT_KEY_TYPE_AES=y
CONFIG_PSA_WANT_ALG_GCM=y
CONFIG_PSA_WANT_ALG_ECDH=y
CONFIG_PSA_WANT_ALG_ECDSA=y
CONFIG_PSA_WANT_ECC_SECP_R1_256=y
CONFIG_PSA_WANT_KEY_TYPE_ECC_KEY_PAIR_IMPORT=y
CONFIG_PSA_WANT_KEY_TYPE_ECC_KEY_PAIR_EXPORT=y
CONFIG_PSA_WANT_KEY_TYPE_ECC_KEY_PAIR_GENERATE=y
CONFIG_MBEDTLS_SSL_SRV_C=n
CONFIG_NET_SOCKETS_ENABLE_DTLS=n
```

## src/main.c
```c
/* SPDX-License-Identifier: AGPL-3.0-only */
#include <errno.h>
#include <zephyr/kernel.h>
#include <zephyr/drivers/gpio.h>
#include <zephyr/drivers/watchdog.h>
#include <zephyr/bluetooth/bluetooth.h>
#include <zephyr/sys/atomic.h>
#include "conflict_monitor.h"

/* No pump protocol, scan, connection request, network destination or credentials.
 * The bench result is local only; this image never commands delivery. */
static const struct gpio_dt_spec carbs = GPIO_DT_SPEC_GET(DT_ALIAS(sw0), gpios);
static const struct gpio_dt_spec concert = GPIO_DT_SPEC_GET(DT_ALIAS(sw1), gpios);
static const struct device *const watchdog = DEVICE_DT_GET(DT_ALIAS(watchdog0));
static struct gpio_callback carb_callback, concert_callback;
static atomic_t pending;
static struct mmu_ledger ledger;
static struct mmu_result last_result;

static void button_event(const struct device *port, struct gpio_callback *cb, uint32_t pins)
{
    ARG_UNUSED(port);
    ARG_UNUSED(pins);
    /* ISR only latches a bounded event. Main owns all evaluator state. */
    atomic_or(&pending, cb == &carb_callback ? 1 : 2);
}

static int configure_button(const struct gpio_dt_spec *button, struct gpio_callback *cb)
{
    int err;
    if (!gpio_is_ready_dt(button)) { return -ENODEV; }
    err = gpio_pin_configure_dt(button, GPIO_INPUT);
    if (err != 0) { return err; }
    gpio_init_callback(cb, button_event, BIT(button->pin));
    err = gpio_add_callback(button->port, cb);
    if (err != 0) { return err; }
    return gpio_pin_interrupt_configure_dt(button, GPIO_INT_EDGE_TO_ACTIVE);
}

int main(void)
{
    struct wdt_timeout_cfg timeout = {
        .window = {.min = 0, .max = 10000},
        .callback = NULL,
        .flags = WDT_FLAG_RESET_SOC
    };
    struct mmu_state state = mmu_init((uint64_t)k_uptime_get());
    uint64_t last_carb = 0, last_concert = 0;
    bool seen_carb = false, seen_concert = false;
    int channel, err;
    if (!device_is_ready(watchdog)) { return -ENODEV; }
    channel = wdt_install_timeout(watchdog, &timeout);
    if (channel < 0) { return channel; }
    err = wdt_setup(watchdog, 0); /* watchdog continues during sleep/debug halt */
    if (err != 0) { return err; }
    err = configure_button(&carbs, &carb_callback);
    if (err != 0) { return err; } /* no further feed: reset after setup failure */
    err = configure_button(&concert, &concert_callback);
    if (err != 0) { return err; }
    /* Host/HCI initialization only; the cpunet image owns the controller. */
    err = bt_enable(NULL);
    if (err != 0) { return err; }

    for (;;) {
        uint64_t now = (uint64_t)k_uptime_get();
        atomic_val_t events = atomic_set(&pending, 0);
        int carb_level = gpio_pin_get_dt(&carbs);
        int concert_level = gpio_pin_get_dt(&concert);
        struct mmu_input input = {0};
        if (carb_level < 0 || concert_level < 0) { return -EIO; }
        /* Sample held inputs too: a held button at boot must not be missed.
         * Bounce coalesces; repeated events can only extend protection. */
        if (((events & 1) || carb_level) && (!seen_carb || now - last_carb >= 50)) {
            state = mmu_preempt(state, now, true);
            last_carb = now; seen_carb = true;
        }
        if (((events & 2) || concert_level) && (!seen_concert || now - last_concert >= 50)) {
            state = mmu_preempt(state, now, false);
            last_concert = now; seen_concert = true;
        }
        input.now_ms = now;
        /* No schedule/delivery adapter exists. Do not invent a delivery history,
         * issue green proposals or use the 55% rule as a treatment instruction. */
        last_result = mmu_evaluate(state, input, &ledger);
        state = last_result.state;
        if (!last_result.valid) { return -EINVAL; }
        if (wdt_feed(watchdog, channel) != 0) { return -EIO; }
        k_sleep(K_TIMEOUT_ABS_MS((int64_t)(now + 1000)));
    }
}
```

## src/conflict_monitor.c
```c
/* SPDX-License-Identifier: AGPL-3.0-only */
#include "conflict_monitor.h"

static uint64_t deadline(uint64_t now, uint64_t delta)
{
    return now > UINT64_MAX - delta ? UINT64_MAX : now + delta;
}

struct mmu_state mmu_init(uint64_t now_ms)
{
    struct mmu_state s = {0};
    s.last_ms = now_ms;
    /* Reset cannot clear a potentially active 180-minute protection interval. */
    s.lockout_until_ms = deadline(now_ms, MMU_CONCERT_MS);
    return s;
}

static void clear_green(struct mmu_state *s, uint64_t now)
{
    if (s->green) {
        uint64_t until = deadline(now, MMU_LOCKOUT_MS);
        if (until > s->lockout_until_ms) { s->lockout_until_ms = until; }
    }
    s->green = false;
    s->green_since_ms = 0;
    s->command_end_ms = 0;
}

bool mmu_record(struct mmu_ledger *l, uint64_t minute,
                uint32_t scheduled, uint32_t observed)
{
    if (l == NULL) { return false; }
    if (l->count > MMU_BINS || l->next >= MMU_BINS ||
        scheduled > MMU_MAX_UNITS || observed > MMU_MAX_UNITS) {
        l->count = 0; l->next = 0;
        return false;
    }
    if (l->count != 0) {
        uint64_t last = l->bins[(l->next + MMU_BINS - 1) % MMU_BINS].minute;
        if (minute <= last) {
            l->count = 0; l->next = 0;
            return false;
        }
        if (minute - last != 1) { l->count = 0; l->next = 0; }
    }
    l->bins[l->next] = (struct mmu_bin){minute, scheduled, observed};
    l->next = (l->next + 1) % MMU_BINS;
    if (l->count < MMU_BINS) { ++l->count; }
    return true;
}

bool mmu_budget_allows(const struct mmu_ledger *l, uint64_t now_minute,
                       uint32_t scheduled, uint32_t candidate, uint32_t minutes)
{
    uint64_t sum_s = 0, sum_o = 0;
    size_t i;
    if (l == NULL || l->count != MMU_BINS || l->next >= MMU_BINS ||
        now_minute < MMU_BINS || scheduled == 0 || scheduled > MMU_MAX_UNITS ||
        candidate > scheduled || minutes == 0 || minutes > 30) { return false; }
    for (i = 0; i < MMU_BINS; ++i) {
        const struct mmu_bin *b = &l->bins[(l->next + i) % MMU_BINS];
        if (b->minute != now_minute - MMU_BINS + i ||
            b->scheduled > MMU_MAX_UNITS || b->observed > MMU_MAX_UNITS) { return false; }
        sum_s += b->scheduled;
        sum_o += b->observed;
    }
    if (sum_s == 0 || sum_o * 100 < sum_s * 55) { return false; }
    /* Check every projected minute of a flat-profile command, on totals only.
     * No candidate value is ever recorded as observed delivery. */
    for (i = 0; i < minutes; ++i) {
        const struct mmu_bin *b = &l->bins[(l->next + i) % MMU_BINS];
        sum_s = sum_s - b->scheduled + scheduled;
        sum_o = sum_o - b->observed + candidate;
        if (sum_s == 0 || sum_o * 100 < sum_s * 55) { return false; }
    }
    return true;
}

static bool state_valid(struct mmu_state s, uint64_t now)
{
    return !s.fault && now >= s.last_ms &&
           (!s.green || (s.green_since_ms <= s.last_ms &&
             s.command_end_ms > s.green_since_ms &&
             s.command_end_ms - s.green_since_ms <= MMU_MAX_GREEN_MS));
}

struct mmu_state mmu_preempt(struct mmu_state s, uint64_t now, bool carbs)
{
    uint64_t until;
    if (!state_valid(s, now)) { s.fault = true; return s; }
    clear_green(&s, now);
    until = deadline(now, MMU_LOCKOUT_MS);
    if (until > s.lockout_until_ms) { s.lockout_until_ms = until; }
    if (carbs) { s.carb_until_ms = deadline(now, MMU_CARB_MS); }
    else { s.concert_until_ms = deadline(now, MMU_CONCERT_MS); }
    s.last_ms = now;
    return s;
}

struct mmu_result mmu_evaluate(struct mmu_state s, struct mmu_input in,
                               const struct mmu_ledger *ledger)
{
    struct mmu_result r = {s, in.scheduled, true, MMU_SCHEDULE};
    uint32_t duration = in.duration_ms;
    if (!state_valid(s, in.now_ms) || in.scheduled > MMU_MAX_UNITS ||
        in.requested > MMU_MAX_UNITS ||
        (in.request_green && (duration == 0 || in.now_ms > UINT64_MAX - MMU_MAX_GREEN_MS))) {
        r.state.fault = true;
        clear_green(&r.state, in.now_ms);
        r.valid = false; r.simulated_basal = 0; r.reason = MMU_INVALID;
        return r;
    }
    r.state.last_ms = in.now_ms;
    if (duration > MMU_MAX_GREEN_MS) { duration = (uint32_t)MMU_MAX_GREEN_MS; }
    if (s.green && (in.now_ms - s.green_since_ms >= MMU_MAX_GREEN_MS ||
                    in.now_ms >= s.command_end_ms)) { r.reason = MMU_WATCHDOG; }
    else if (in.manual_clearance) {
        uint64_t until = deadline(in.now_ms, MMU_LOCKOUT_MS);
        if (until > r.state.lockout_until_ms) { r.state.lockout_until_ms = until; }
    }
    else if (in.now_ms < s.carb_until_ms) { r.reason = MMU_CARB; }
    else if (in.now_ms < s.concert_until_ms) { r.reason = MMU_CONCERT; }
    else if (!in.request_green || in.requested >= in.scheduled) { /* schedule */ }
    else if (in.now_ms < s.lockout_until_ms) { r.reason = MMU_LOCKOUT; }
    else if (!mmu_budget_allows(ledger, in.now_ms / MMU_MINUTE_MS,
                  in.scheduled, in.requested,
                  (duration + (uint32_t)MMU_MINUTE_MS - 1) / (uint32_t)MMU_MINUTE_MS)) {
        r.reason = MMU_BUDGET;
    }
    else {
        r.reason = MMU_BOUNDED;
        r.simulated_basal = in.requested; /* already strictly below schedule */
        if (!s.green) {
            r.state.green = true;
            r.state.green_since_ms = in.now_ms;
            r.state.command_end_ms = in.now_ms + duration;
        }
        /* A repeated proposal can shorten, never renew, the original lease. */
        if (in.now_ms + duration < r.state.command_end_ms) {
            r.state.command_end_ms = in.now_ms + duration;
        }
        return r;
    }
    clear_green(&r.state, in.now_ms);
    return r;
}
```

## src/conflict_monitor.h
```c
/* SPDX-License-Identifier: AGPL-3.0-only */
#ifndef LIVE_CONFLICT_MONITOR_H
#define LIVE_CONFLICT_MONITOR_H
#include <stdbool.h>
#include <stddef.h>
#include <stdint.h>

/* Research units per minute, not a pump wire format or a dosing API. */
#define MMU_MINUTE_MS UINT64_C(60000)
#define MMU_MAX_GREEN_MS (30 * MMU_MINUTE_MS)
#define MMU_LOCKOUT_MS (15 * MMU_MINUTE_MS)
#define MMU_CARB_MS (60 * MMU_MINUTE_MS)
#define MMU_CONCERT_MS (180 * MMU_MINUTE_MS)
#define MMU_BINS 180U
#define MMU_MAX_UNITS UINT32_C(1000000)

struct mmu_bin { uint64_t minute; uint32_t scheduled, observed; };
struct mmu_ledger {
    struct mmu_bin bins[MMU_BINS];
    size_t count, next;
};
struct mmu_state {
    uint64_t last_ms, green_since_ms, command_end_ms;
    uint64_t lockout_until_ms, carb_until_ms, concert_until_ms;
    bool green, fault;
};
struct mmu_input {
    uint64_t now_ms;
    uint32_t scheduled, requested, duration_ms;
    bool request_green, manual_clearance;
};
enum mmu_reason {
    MMU_SCHEDULE, MMU_BOUNDED, MMU_WATCHDOG, MMU_CARB,
    MMU_CONCERT, MMU_LOCKOUT, MMU_BUDGET, MMU_INVALID
};
struct mmu_result {
    struct mmu_state state;
    uint32_t simulated_basal;
    bool valid;
    enum mmu_reason reason;
};

/* Explicit state, no hidden globals, clocks, I/O or allocation in the evaluator. */
struct mmu_state mmu_init(uint64_t now_ms);
bool mmu_record(struct mmu_ledger *ledger, uint64_t minute,
                uint32_t scheduled, uint32_t observed);
bool mmu_budget_allows(const struct mmu_ledger *ledger, uint64_t now_minute,
                       uint32_t scheduled, uint32_t candidate, uint32_t minutes);
struct mmu_state mmu_preempt(struct mmu_state previous, uint64_t now_ms, bool carbs);
struct mmu_result mmu_evaluate(struct mmu_state previous, struct mmu_input input,
                               const struct mmu_ledger *ledger);
#endif
```
